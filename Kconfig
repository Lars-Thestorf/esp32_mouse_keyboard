## Kconfig
```kconfig
menu "BLE_HID"

	config BLEHID_USEKEYBOARD
		bool "Enable BLE-HID keyboard"
		default y
		help
			Enable the Keyboard interface for Bluetooth.
			
	config BLEHID_USECONSUMER
		bool "Enable BLE-HID keyboard consumer keys"
		default y
		help
			Enable the Keyboard consumer keys interface for Bluetooth.
			
	config BLEHID_USEMOUSE
		bool "Enable BLE-HID mouse"
		default y
		help
			Enable the Mouse interface for Bluetooth.

	config BLEHID_USEABSOLUTEMOUSE
		depends on MODULE_USEMOUSE
		bool "Use absolute mouse instead of classic relative mouse (UNUSED)"
		default n
		help
			If enabled, the normal relative mouse is replaced with an
			absolute mouse descriptor. Please note, that a different mouse
			input data is used if enabled (we need int16_t for x and y).

	config BLEHID_USEJOYSTICK
		bool "Enable BLE-HID joystick (UNUSED)"
		default n
		help
			Enable the Joystick interface for Bluetooth.
			
	config BLEHID_BT_PAIRING
		bool "Disable pairing by default, enabled by command"
		default n
		help
			If enabled, the module denies pairing requests by default.
			It is possible to enable the pairing by sending the pairing en-/disable command
			via the serial interface.

endmenu
```
